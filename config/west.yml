## config/west.yml
```yaml
manifest:
  remotes:
    - name: zmkfirmware
      url-base: https://github.com/zmkfirmware
    - name: janpfischer
      url-base: https://github.com/janpfischer
    - name: jeonghyeonjin
      url-base: https://github.com/jeonghyeonjin
  projects:
    - name: zmk
      remote: zmkfirmware
      revision: v0.3.0
      import: app/west.yml
    - name: zmk-dongle-screen
      remote: janpfischer
      revision: 0.1.2
    - name: zmk-paw3395-driver
      remote: jeonghyeonjin
      revision: main
  self:
    path: config
```
